## config/boards/shields/varja/Kconfig.defconfig
```kconfig
# Copyright (c) 2024 The ZMK Contributors
# SPDX-License-Identifier: MIT

if SHIELD_VARJA

config ZMK_KEYBOARD_NAME
    default "Varja"

config ZMK_ENCODER
    default y

endif
```
